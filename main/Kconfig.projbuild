## main/Kconfig.projbuild
```kconfig
menu "Operator Authorization Application"

    config APP_ENABLE_SD_CARD
        bool "Write access log to SD card (optional)"
        default n
        help
            When enabled, the system tries to mount an SD card in SPI mode at
            startup and appends every recognition attempt to
            /sdcard/access_log.csv. If no SD card is inserted, or this option
            is disabled, access logs are written to the serial port only; the
            system works fully without this feature.

endmenu
```
